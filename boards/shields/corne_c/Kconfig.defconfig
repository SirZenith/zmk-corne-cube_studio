## boards/shields/corne_c/Kconfig.defconfig
```kconfig
if SHIELD_CORNE_C_DONGLE

config ZMK_KEYBOARD_NAME
    default "Corne C Dongle"

config ZMK_SPLIT_ROLE_CENTRAL
    default y

endif # SHIELD_CORNE_C_DONGLE

if SHIELD_CORNE_C_LEFT

config ZMK_KEYBOARD_NAME
    default "Corne C"

config ZMK_SPLIT_ROLE_CENTRAL
    default y

endif # SHIELD_CORNE_C_LEFT

if SHIELD_CORNE_C_LEFT_PERIPHERAL || SHIELD_CORNE_C_RIGHT

config ZMK_SPLIT_ROLE_CENTRAL
    default n

endif # SHIELD_CORNE_C_LEFT_PERIPHERAL || SHIELD_CORNE_C_RIGHT

if SHIELD_CORNE_C_LEFT || SHIELD_CORNE_C_RIGHT || SHIELD_CORNE_C_LEFT_PERIPHERAL || SHIELD_CORNE_C_DONGLE

config ZMK_SPLIT
    default y

if ZMK_DISPLAY

config I2C
    default y

config SSD1306
    default y

endif # ZMK_DISPLAY

if LVGL

config LV_Z_VDB_SIZE
    default 64

config LV_DPI_DEF
    default 148

config LV_Z_BITS_PER_PIXEL
    default 1

choice LV_COLOR_DEPTH
    default LV_COLOR_DEPTH_1
endchoice

endif # LVGL

endif
```

## config/west.yml
```yaml
manifest:
  remotes:
    - name: zmkfirmware
      url-base: https://github.com/zmkfirmware
    # -------------------------------------------------------------------------
    - name: englmaxi
      url-base: https://github.com/englmaxi
    - name: sirzenith
      url-base: https://github.com/SirZenith
  projects:
    - name: zmk
      remote: zmkfirmware
      revision: main
      import: app/west.yml
    # -------------------------------------------------------------------------
    - name: nice-view-gem
      remote: sirzenith
      revision: main
    - name: zmk-dongle-display
      remote: englmaxi
      revision: main
  self:
    path: config
```
